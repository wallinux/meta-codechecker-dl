## conf/layer.conf
```bitbake
BBFILE_COLLECTIONS += "meta-codechecker-dl"
BBFILE_PATTERN_meta-codechecker-dl = ""
BBFILE_PATTERN_IGNORE_EMPTY_meta-codechecker-dl = "1"

LAYERSERIES_COMPAT_meta-codechecker-dl = "dunfell gatesgarth"

# We have a pre-populated downloads directory, add to PREMIRRORS
PREMIRRORS_prepend = " \
     .*://.*/.* file://${LAYERDIR}/downloads/ \n \
     git://.*/.* git://${LAYERDIR}/git/MIRRORNAME;protocol=file \n \
     gitsm://.*/.* gitsm://${LAYERDIR}/git/MIRRORNAME;protocol=file \n \
"
```
